## arch/riscv/cpu/sun20i_d1/Kconfig
```kconfig
# SPDX-License-Identifier: GPL-2.0+

config SUN20I_D1
	bool
	select ARCH_EARLY_INIT_R
	select BINMAN if SPL
	select CLK_SUN20I_D1
	select DRAM_SUN20I_D1
	select EFI_EXIT_BOOT_SERVICES_CLEANUP if EFI_LOADER
	select PINCTRL_SUN20I_D1
	select SUNXI_GEN_NCAT2
	select SUNXI_NEW_PINCTRL
	select SYS_CACHE_SHIFT_6
	select SYS_CACHE_THEAD_CMO
	imply CMD_CPU
	imply CPU
	imply CPU_RISCV
	imply OF_UPSTREAM
	imply RISCV_ACLINT if RISCV_MMODE
	imply RISCV_TIMER if (RISCV_SMODE || SPL_RISCV_SMODE)
	imply SPL_CPU
	imply SPL_LOAD_FIT
	imply SPL_OPENSBI
	imply SPL_RISCV_ACLINT if SPL_RISCV_MMODE
```

## board/sunxi/Kconfig.riscv
```kconfig
if TARGET_SUN20I_D1

config SYS_BOARD
	default "sunxi"

config SYS_SOC
	default "sunxi"

config SYS_CONFIG_NAME
	default "sun20i"

config SYS_CPU
	default "sun20i_d1"

config TEXT_BASE
	default 0x42e00000

config SPL_TEXT_BASE
	default 0x20060

config SPL_MAX_SIZE
	default 0x27fa0

config SPL_STACK
	default 0x48000

config SPL_SHARES_INIT_SP_ADDR
	default n

config SPL_HAVE_INIT_STACK
	default y

config SPL_BSS_START_ADDR
	default 0x4ff80000

config SPL_STACK_R_ADDR
	default 0x4fe00000

config SPL_OPENSBI_LOAD_ADDR
	default 0x40000000

config SYS_LOAD_ADDR
	default 0x42000000

config PRE_CON_BUF_ADDR
	default 0x43000000

config DEBUG_UART_BOARD_INIT
	default y

config DEBUG_UART_BASE
	default 0x2500000

config DEBUG_UART_CLOCK
	default 24000000

config DEBUG_UART_SHIFT
	default 2

config SYS_NS16550_MEM32
	default y

config SYS_MMCSD_RAW_MODE_U_BOOT_SECTOR
	default 0x40

config SYS_MMCSD_RAW_MODE_U_BOOT_DATA_PART_OFFSET
	default 0x10

config SUNXI_GEN_NCAT2
	bool
	select MMC_SUNXI_HAS_NEW_MODE
	select SUPPORT_SPL

config SUNXI_MINIMUM_DRAM_MB
	int "minimum DRAM size"
	default 64

config SUNXI_SRAM_ADDRESS
	hex
	default 0x20000

config SUNXI_DRAM_MAX_SIZE
	hex
	default 0x80000000

config DRAM_CLK
	int "sunxi dram clock speed"
	default 792

config DRAM_ZQ
	int "sunxi dram zq value"
	default 8092667

config SYS_CLK_FREQ
	default 1008000000

config BOARD_SPECIFIC_OPTIONS
	def_bool y
	select BINMAN
	select BOARD_LATE_INIT
	select BOARD_SUNXI
	select CLK
	select DM_GPIO
	select DM_RESET
	select DM_SERIAL
	select FIT
	select OF_BOARD_SETUP
	select OF_CONTROL
	select PINCTRL
	select RAM if SPL_DM
	select SPL_CLK if SPL_DM
	select SPL_DM if SPL
	select SPL_DM_RESET if SPL_CLK
	select SPL_GPIO if SPL
	select SPL_LOAD_FIT if SPL
	select SPL_MMC if SPL
	select SPL_OF_CONTROL if SPL_DM
	select SPL_PINCONF if SPL_DM
	select SPL_PINCTRL if SPL_DM
	select SPL_RAM if SPL_DM
	select SPL_SYS_MALLOC if SPL
	select SUPPORT_SPL
	select SUN20I_D1
	select SUNXI_GPIO
	select SYS_NS16550
	select USE_PREBOOT
	imply CMD_DM
	imply CMD_EXT2
	imply CMD_EXT4
	imply CMD_FAT
	imply CMD_FS_GENERIC
	imply CMD_GPIO
	imply CMD_MMC
	imply CMD_NET
	imply CMD_PING
	imply CMD_USB if USB_HOST
	imply BOOTSTD_DEFAULTS
	imply CONSOLE_MUX if USB_KEYBOARD
	imply CMD_GPT
	imply CMD_SYSBOOT
	imply DM_REGULATOR
	imply DM_REGULATOR_FIXED
	imply DOS_PARTITION
	imply EFI_PARTITION
	imply FAT_WRITE
	imply MMC
	imply NET_RANDOM_ETHADDR
	imply OF_LIBFDT_OVERLAY
	imply PARTITION_TYPE_GUID if EFI_PARTITION
	imply PRE_CONSOLE_BUFFER
	imply PHYLIB
	imply SPL
	imply SPL_SYS_MMCSD_RAW_MODE
	imply SYS_CONSOLE_IS_IN_ENV if USB_KEYBOARD
	imply SYSRESET
	imply SYSRESET_SBI
	imply SYSRESET_WATCHDOG
	imply SYSRESET_WATCHDOG_AUTO
	imply USB
	imply USB_EHCI_GENERIC
	imply USB_EHCI_HCD
	imply USB_GADGET
	imply USB_KEYBOARD if USB_HOST
	imply USB_OHCI_GENERIC
	imply USB_OHCI_HCD
	imply USB_STORAGE if USB_HOST
	imply WDT

endif
```

## configs/lichee_rv_dock_defconfig
```kconfig
CONFIG_RISCV=y
CONFIG_HAS_CUSTOM_SYS_INIT_SP_ADDR=y
CONFIG_CUSTOM_SYS_INIT_SP_ADDR=0x43e00000
CONFIG_DEFAULT_DEVICE_TREE="allwinner/sun20i-d1-lichee-rv-dock"
CONFIG_DRAM_SUNXI_ODT_EN=0x1
CONFIG_DRAM_SUNXI_TPR0=0x004a2195
CONFIG_DRAM_SUNXI_TPR11=0x00870000
CONFIG_DRAM_SUNXI_TPR12=0x00000024
CONFIG_DRAM_SUNXI_TPR13=0x34050100
CONFIG_TARGET_SUN20I_D1=y
CONFIG_ARCH_RV64I=y
CONFIG_RISCV_SMODE=y
CONFIG_DEBUG_UART_NS16550=y
# CONFIG_SPL_SMP is not set
CONFIG_SPL_OPENSBI_SCRATCH_OPTIONS=0x0
```
